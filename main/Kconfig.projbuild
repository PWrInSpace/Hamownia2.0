## main/Kconfig.projbuild
```kconfig
menu "HAMOWNIA2.0 config ESP32"

    menu "Board GPIO pinout"

        config AD7190_CS
            int "AD7190 CS pin number"
            default 17
            help
                GPIO pin number for AD7190 CS
                
        config SPI_RDY
            int "SPI RDY pin number"
            default 4
            help
                GPIO pin number for SPI RDY

        config LORA_RS
            int "LORA RS pin number"
            default 15
            help
                GPIO pin number for LORA RS

        config LORA_CS
            int "LORA CS pin number"
            default 7
            help
                GPIO pin number for LORA CS

        config GPIO_RS
            int "GPIO EXPANDER RESET pin number"
            default 20
            help
                GPIO pin number for GPIO expander RESET

        config CAN_RX
            int "CAN RX pin number"
            default 35
            help
                GPIO pin number for CAN RX

        config CAN_TX
            int "CAN TX pin number"
            default 36
            help
                GPIO pin number for CAN TX

        config SPI_SCK
            int "SPI SCK pin number"
            default 6
            help
                GPIO pin number for SPI SCK
        
        config SPI_MISO
            int "SPI MISO pin number"
            default 4
            help
                GPIO pin number for SPI MISO

        config I2C_SDA
            int "I2C SDA pin number"
            default 8
            help
                GPIO pin number for I2C SDA

        config I2C_SCL
            int "I2C SCL pin number"
            default 19
            help
                GPIO pin number for I2C SCL

        config SPI_MOSI
            int "SPI MOSI pin number"
            default 5
            help
                GPIO pin number for SPI MOSI

        
        config IGNIT_FIRE_2
            int "FIRE_2 pin number"
            default 9
            help
                GPIO pin number for Igniter Fire 2

        config IGNIT_FIRE_1
            int "FIRE_1 pin number"
            default 11
            help
                GPIO pin number for Igniter Fire 1
        
        config SD_CS
            int "SD CS pin number"
            default 18
            help
                GPIO pin number for SD CS

        config LORA_D0
            int "LORA D0 pin number"
            default 16
            help
                GPIO pin number for LORA D0

        config VALVE1_PWM_PIN
            int "Valve1 pwm pin number"
            default 14
            help
                GPIO pin number for pwm for valve

        config VALVE2_PWM_PIN
            int "Valve2 pwm pin number"
            default 21
            help
                GPIO pin number for pwm for valve

    endmenu

    menu "SPI configuration"

        config SPI_HOST
            int "Port Number"
            default 0
            help
                Port number for SPI device.

        config SPI_FREQUENCY
            int "Master Frequency"
            default 100000
            help
                SPI clock frequency device.
    endmenu

    menu "I2C configuration"

        config I2C_MASTER_PORT_NUM
            int "Port Number"
            default 0
            help
                Port number for I2C Master device.

        config I2C_MASTER_FREQUENCY
            int "Master Frequency"
            default 400000
            help
                I2C frequency of Master device.

        config I2C_MASTER_TIMEOUT_MS
            int "Master Timeout"
            default 1000
            help
                Timeout of I2C Master device.

        config I2C_MCP23018_ADDR
            int "MCP23018 I2C address 0x27"
            default 39
            help
                I2C address of MCP23018 device.

        config I2C_ADS1115_ADDR
            int "ADS1115 I2C address 0x49"
            default 73
            help
                I2C address of ADS1115 device.

    endmenu

endmenu
```
